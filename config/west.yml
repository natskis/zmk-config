## config/west.yml
```yaml
manifest:
  remotes:
    - name: zmkfirmware
      url-base: https://github.com/zmkfirmware
    - name: nickw
      url-base: https://github.com/Nick-W
  projects:
    - name: zmk
      remote: zmkfirmware
      revision: main
      import: app/west.yml
    - name: zmk-shield-nice-view
      remote: nickw
      revision: main
  self:
    path: config
```
